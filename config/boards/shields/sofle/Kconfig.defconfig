## config/boards/shields/sofle/Kconfig.defconfig
```kconfig
if SHIELD_SOFLE_LEFT

config ZMK_SOFLE
    default "Sofle"

config ZMK_SPLIT_BLE_ROLE_CENTRAL
    default y

endif

if SHIELD_SOFLE_LEFT || SHIELD_SOFLE_RIGHT

config ZMK_SPLIT
    default y

endif
```

## config/boards/shields/sofle_rgb/kconfig.shield
```kconfig
config SHIELD_SOFLE_RGB_LEFT
       def_bool $(shields_list_contains,sofle_rgb_left,(SHIELD_LIST))

config SHIELD_SOFLE_RGB_RIGHT
       def_bool $(shields_list_contains,sofle_rgb_right,(SHIELD_LIST))
```
